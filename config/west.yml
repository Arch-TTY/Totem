## config/west.yml
```yaml
manifest:
  remotes:
    - name: zmkfirmware
      url-base: https://github.com/zmkfirmware
    - name: joelspadin
      url-base: https://github.com/joelspadin
    - name: arch-tty
      url-base: https://github.com/arch-tty
  projects:
    - name: zmk
      remote: zmkfirmware
      revision: main
      import: app/west.yml
    - name: prospector-zmk-module
      remote: arch-tty
      revision: feat/new-status-screens
    - name: zmk-locales
      remote: joelspadin
      revision: main
  self:
    path: config
```
